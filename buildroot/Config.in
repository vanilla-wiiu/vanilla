## buildroot/Config.in
```kconfig
source "$BR2_EXTERNAL_VANILLA_PATH/package/Config.in"

config BR2_LINUX_TEGRA_T210_DEPS
	bool "Fetch out-of-tree Tegra T210 kernel dependencies"
	depends on BR2_LINUX_KERNEL
	help
	  Clone the out-of-tree nvidia/switchroot kernel repos
	  (nvgpu, soc-t210, platform-nx, etc.) after kernel extraction.
	  Required for Tegra T210 (Nintendo Switch) L4T builds.
```

## buildroot/configs/nx_defconfig
```kconfig
BR2_aarch64=y
BR2_cortex_a57=y
BR2_PACKAGE_HOST_LINUX_HEADERS_CUSTOM_4_9=y
BR2_TOOLCHAIN_BUILDROOT_CXX=y
BR2_ROOTFS_DEVICE_CREATION_DYNAMIC_EUDEV=y
# BR2_TARGET_GENERIC_REMOUNT_ROOTFS_RW is not set
BR2_ROOTFS_OVERLAY="$(BR2_EXTERNAL_VANILLA_PATH)/rootfs $(BR2_EXTERNAL_VANILLA_PATH)/board/nx/rootfs/"
BR2_LINUX_KERNEL=y
BR2_LINUX_KERNEL_CUSTOM_GIT=y
BR2_LINUX_KERNEL_CUSTOM_REPO_URL="https://github.com/CTCaer/switch-l4t-kernel-4.9.git"
BR2_LINUX_KERNEL_CUSTOM_REPO_VERSION="linux-5.1.2"
BR2_LINUX_KERNEL_DEFCONFIG="tegra_linux"
BR2_PACKAGE_FFMPEG=y
# BR2_PACKAGE_FFMPEG_FFMPEG is not set
BR2_PACKAGE_FFMPEG_SWSCALE=y
BR2_PACKAGE_FFMPEG_ENCODERS="png"
BR2_PACKAGE_FFMPEG_MUXERS="image2 mp4"
BR2_PACKAGE_FFMPEG_DEMUXERS=""
BR2_PACKAGE_FFMPEG_PARSERS=""
BR2_PACKAGE_FFMPEG_BSFS=""
BR2_PACKAGE_FFMPEG_PROTOCOLS=""
BR2_PACKAGE_FFMPEG_FILTERS=""
# BR2_PACKAGE_FFMPEG_INDEVS is not set
# BR2_PACKAGE_FFMPEG_OUTDEVS is not set
BR2_PACKAGE_KMSCUBE=y
BR2_PACKAGE_MESA3D=y
BR2_PACKAGE_MESA3D_GALLIUM_DRIVER_TEGRA=y
BR2_PACKAGE_MESA3D_OPENGL_EGL=y
BR2_PACKAGE_MESA3D_OPENGL_ES=y
BR2_PACKAGE_SDL2=y
BR2_PACKAGE_SDL2_KMSDRM=y
BR2_PACKAGE_SDL2_OPENGLES=y
BR2_PACKAGE_SDL2_IMAGE=y
BR2_PACKAGE_SDL2_TTF=y
BR2_PACKAGE_ALSA_LIB=y
BR2_PACKAGE_OPENSSL=y
BR2_PACKAGE_LIBXML2=y
BR2_PACKAGE_LIBNL=y
BR2_PACKAGE_READLINE=y
BR2_TARGET_ROOTFS_CPIO=y
BR2_TARGET_ROOTFS_CPIO_GZIP=y
BR2_TARGET_ROOTFS_CPIO_UIMAGE=y
# BR2_TARGET_ROOTFS_TAR is not set
BR2_PACKAGE_HOST_E2FSPROGS=y
BR2_PACKAGE_NEXMON=y
BR2_PACKAGE_VANILLA=y
BR2_LINUX_TEGRA_T210_DEPS=y
```

## buildroot/configs/vanilla_nx_defconfig
```kconfig
BR2_aarch64=y
BR2_cortex_a57=y
BR2_PACKAGE_HOST_LINUX_HEADERS_CUSTOM_4_9=y
BR2_TOOLCHAIN_BUILDROOT_CXX=y
BR2_TOOLCHAIN_GLIBC_GCONV_LIBS_COPY=y
BR2_ROOTFS_DEVICE_CREATION_DYNAMIC_EUDEV=y
BR2_TARGET_GENERIC_ROOT_PASSWD="root"
# BR2_TARGET_GENERIC_GETTY is not set
# BR2_TARGET_GENERIC_REMOUNT_ROOTFS_RW is not set
BR2_ROOTFS_OVERLAY="$(BR2_EXTERNAL_VANILLA_PATH)/board/nx/rootfs/"
BR2_ROOTFS_POST_BUILD_SCRIPT="$(BR2_EXTERNAL_VANILLA_PATH)/board/nx/post_build.sh"
BR2_LINUX_KERNEL=y
BR2_LINUX_KERNEL_CUSTOM_GIT=y
BR2_LINUX_KERNEL_CUSTOM_REPO_URL="https://github.com/theofficialgman/switch-l4t-kernel-4.9.git"
BR2_LINUX_KERNEL_CUSTOM_REPO_VERSION="linux-theofficialgman-5-2-2026"
BR2_LINUX_KERNEL_VERSION="4.9.140"
BR2_LINUX_KERNEL_DEFCONFIG="tegra_linux"
BR2_PACKAGE_ALSA_UTILS=y
# BR2_PACKAGE_ALSA_UTILS_ALSAMIXER is not set
BR2_PACKAGE_ALSA_UTILS_AMIXER=y
BR2_PACKAGE_FFMPEG=y
# BR2_PACKAGE_FFMPEG_FFMPEG is not set
BR2_PACKAGE_FFMPEG_SWSCALE=y
BR2_PACKAGE_FFMPEG_ENCODERS="png"
BR2_PACKAGE_FFMPEG_DECODERS="h264"
BR2_PACKAGE_FFMPEG_MUXERS="image2 mp4"
BR2_PACKAGE_FFMPEG_DEMUXERS=""
BR2_PACKAGE_FFMPEG_PARSERS=""
BR2_PACKAGE_FFMPEG_BSFS=""
BR2_PACKAGE_FFMPEG_PROTOCOLS=""
BR2_PACKAGE_FFMPEG_FILTERS=""
# BR2_PACKAGE_FFMPEG_INDEVS is not set
# BR2_PACKAGE_FFMPEG_OUTDEVS is not set
BR2_PACKAGE_LIBGLVND=y
BR2_PACKAGE_SDL2=y
BR2_PACKAGE_SDL2_X11=y
BR2_PACKAGE_SDL2_OPENGLES=y
BR2_PACKAGE_SDL2_IMAGE=y
BR2_PACKAGE_SDL2_TTF=y
BR2_PACKAGE_XORG7=y
BR2_PACKAGE_XSERVER_XORG_SERVER=y
BR2_PACKAGE_XLIB_LIBXAW=y
BR2_PACKAGE_XLIB_LIBXCOMPOSITE=y
BR2_PACKAGE_XAPP_XINPUT=y
BR2_PACKAGE_XAPP_XRANDR=y
BR2_PACKAGE_XDRIVER_XF86_INPUT_LIBINPUT=y
BR2_PACKAGE_EVTEST=y
BR2_PACKAGE_LIBXCRYPT=y
BR2_PACKAGE_OPENSSL=y
BR2_PACKAGE_LIBGUDEV=y
BR2_PACKAGE_LIBUSB=y
BR2_PACKAGE_MTDEV=y
BR2_PACKAGE_LIBXML2=y
BR2_PACKAGE_LIBNL=y
BR2_PACKAGE_READLINE=y
BR2_TARGET_ROOTFS_CPIO=y
BR2_TARGET_ROOTFS_CPIO_GZIP=y
BR2_TARGET_ROOTFS_CPIO_UIMAGE=y
# BR2_TARGET_ROOTFS_TAR is not set
BR2_PACKAGE_HOST_E2FSPROGS=y
BR2_PACKAGE_NEXMON=y
BR2_PACKAGE_VANILLA=y
# BR2_PACKAGE_VANILLA_USE_DRM is not set
BR2_PACKAGE_VANILLA_USE_LOCAL=y
BR2_PACKAGE_VANILLA_USE_NX_IMU=y
BR2_PACKAGE_VANILLA_LOCAL_PATH="/home/matt/src/vanilla"
BR2_PACKAGE_NVIDIA_TEGRA_BSP=y
BR2_PACKAGE_JOYCOND=y
BR2_LINUX_TEGRA_T210_DEPS=y
```

## buildroot/configs/vanilla_raspberrypi0w_defconfig
```kconfig
BR2_arm=y
BR2_arm1176jzf_s=y
BR2_TOOLCHAIN_EXTERNAL=y
BR2_GLOBAL_PATCH_DIR="board/raspberrypi/patches"
BR2_DOWNLOAD_FORCE_CHECK_HASHES=y
BR2_ROOTFS_DEVICE_CREATION_DYNAMIC_EUDEV=y
BR2_ROOTFS_OVERLAY="$(BR2_EXTERNAL_VANILLA_PATH)/rootfs"
BR2_ROOTFS_POST_BUILD_SCRIPT="board/raspberrypi0w/post-build.sh"
BR2_ROOTFS_POST_IMAGE_SCRIPT="board/raspberrypi0w/post-image.sh"
BR2_LINUX_KERNEL=y
BR2_LINUX_KERNEL_CUSTOM_TARBALL=y
BR2_LINUX_KERNEL_CUSTOM_TARBALL_LOCATION="$(call github,raspberrypi,linux,ac69f097e1fba94502cbd36278db204120a37943)/linux-ac69f097e1fba94502cbd36278db204120a37943.tar.gz"
BR2_LINUX_KERNEL_DEFCONFIG="bcmrpi"
BR2_LINUX_KERNEL_DTS_SUPPORT=y
BR2_LINUX_KERNEL_INTREE_DTS_NAME="broadcom/bcm2708-rpi-zero-w"
BR2_LINUX_KERNEL_NEEDS_HOST_OPENSSL=y
BR2_LINUX_KERNEL_CUSTOM_LOGO_PATH="$(BR2_EXTERNAL_VANILLA_PATH)/boot.png"
BR2_TARGET_GENERIC_GETTY=n
BR2_PACKAGE_BUSYBOX_SHOW_OTHERS=y
BR2_PACKAGE_XZ=y
BR2_PACKAGE_MESA3D=y
BR2_PACKAGE_MESA3D_GALLIUM_DRIVER_VC4=y
BR2_PACKAGE_MESA3D_OPENGL_ES=y
BR2_PACKAGE_SDL2=y
BR2_PACKAGE_SDL2_KMSDRM=y
BR2_PACKAGE_SDL2_OPENGLES=y
BR2_PACKAGE_SDL2_IMAGE=y
BR2_PACKAGE_SDL2_TTF=y
BR2_PACKAGE_LINUX_FIRMWARE=y
BR2_PACKAGE_LINUX_FIRMWARE_RALINK_RT2XX=y
BR2_PACKAGE_RPI_FIRMWARE=y
BR2_PACKAGE_RPI_FIRMWARE_BOOTCODE_BIN=y
BR2_PACKAGE_RPI_FIRMWARE_VARIANT_PI=y
BR2_PACKAGE_RPI_FIRMWARE_CONFIG_FILE="$(BR2_EXTERNAL_VANILLA_PATH)/board/raspberrypi/config_0w.txt"
BR2_PACKAGE_ALSA_LIB=y
BR2_PACKAGE_OPENSSL=y
BR2_PACKAGE_LIBXML2=y
BR2_PACKAGE_LIBNL=y
BR2_PACKAGE_LIBEVDEV=y
BR2_PACKAGE_KMOD=y
BR2_PACKAGE_KMOD_TOOLS=y
BR2_TARGET_ROOTFS_EXT2=y
BR2_TARGET_ROOTFS_EXT2_4=y
BR2_TARGET_ROOTFS_EXT2_SIZE="120M"
# BR2_TARGET_ROOTFS_TAR is not set
BR2_PACKAGE_HOST_DOSFSTOOLS=y
BR2_PACKAGE_HOST_GENIMAGE=y
BR2_PACKAGE_HOST_KMOD_XZ=y
BR2_PACKAGE_HOST_MTOOLS=y
BR2_PACKAGE_RPI_FFMPEG=y
# BR2_PACKAGE_RPI_FFMPEG_FFMPEG is not set
BR2_PACKAGE_RPI_FFMPEG_SWSCALE=y
BR2_PACKAGE_RPI_FFMPEG_ENCODERS="png"
BR2_PACKAGE_RPI_FFMPEG_DECODERS="h264_v4l2m2m"
BR2_PACKAGE_RPI_FFMPEG_MUXERS="mp4 image2"
BR2_PACKAGE_RPI_FFMPEG_DEMUXERS=""
BR2_PACKAGE_RPI_FFMPEG_PARSERS=""
BR2_PACKAGE_RPI_FFMPEG_BSFS=""
BR2_PACKAGE_RPI_FFMPEG_PROTOCOLS=""
BR2_PACKAGE_RPI_FFMPEG_FILTERS=""
# BR2_PACKAGE_RPI_FFMPEG_INDEVS is not set
# BR2_PACKAGE_RPI_FFMPEG_OUTDEVS is not set
BR2_PACKAGE_VANILLA=y
```

## buildroot/package/joycond/Config.in
```kconfig
config BR2_PACKAGE_JOYCOND
	bool "joycond"
	help
		Userspace daemon to combine joy-cons from the hid-nintendo kernel driver

		https://github.com/DanielOgorchock/joycond.git
```

## buildroot/package/nexmon/Config.in
```kconfig
comment "Nexmon needs a Linux kernel to be built"
	depends on !BR2_LINUX_KERNEL

config BR2_PACKAGE_NEXMON
	bool "nexmon"
	depends on BR2_LINUX_KERNEL
	help
		Install patched brcmfmac driver from Nexmon

		https://github.com/seemoo-lab/nexmon
```

## buildroot/package/nvidia-tegra-bsp/Config.in
```kconfig
config BR2_PACKAGE_NVIDIA_TEGRA_BSP
    bool "NVIDIA Tegra proprietary libraries"
    depends on BR2_aarch64
    depends on !BR2_PACKAGE_MESA3D
    select BR2_PACKAGE_HAS_LIBEGL
    select BR2_PACKAGE_HAS_LIBGLES
    select BR2_PACKAGE_LIBGLVND_DISPATCH_EGL if BR2_PACKAGE_LIBGLVND
    select BR2_PACKAGE_LIBGLVND_DISPATCH_GLES if BR2_PACKAGE_LIBGLVND
    help
      NVIDIA proprietary Tegra BSP libraries including
      EGL, GLES, X11 DDX driver, and multimedia libraries
      for Tegra X1 (Nintendo Switch).
```
