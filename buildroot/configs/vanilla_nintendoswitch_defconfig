## buildroot/configs/vanilla_nintendoswitch_defconfig
```kconfig
BR2_aarch64=y
BR2_cortex_a57=y
BR2_PACKAGE_HOST_LINUX_HEADERS_CUSTOM_4_9=y
BR2_TOOLCHAIN_BUILDROOT_CXX=y
BR2_TOOLCHAIN_GLIBC_GCONV_LIBS_COPY=y
# BR2_GLOBAL_PATCH_DIR is not set
BR2_ROOTFS_DEVICE_CREATION_DYNAMIC_EUDEV=y
BR2_TARGET_GENERIC_ROOT_PASSWD="root"
# BR2_TARGET_GENERIC_GETTY is not set
# BR2_TARGET_GENERIC_REMOUNT_ROOTFS_RW is not set
BR2_ROOTFS_OVERLAY="$(BR2_EXTERNAL_VANILLA_PATH)/board/nx/rootfs/ $(BR2_EXTERNAL_VANILLA_PATH)/rootfs/"
BR2_ROOTFS_POST_BUILD_SCRIPT="$(BR2_EXTERNAL_VANILLA_PATH)/board/nx/post_build.sh"
BR2_LINUX_KERNEL=y
BR2_LINUX_KERNEL_CUSTOM_GIT=y
BR2_LINUX_KERNEL_CUSTOM_REPO_URL="https://github.com/theofficialgman/switch-l4t-kernel-4.9.git"
BR2_LINUX_KERNEL_CUSTOM_REPO_VERSION="linux-theofficialgman-8-15-2026"
BR2_LINUX_KERNEL_DEFCONFIG="tegra_linux"
BR2_LINUX_KERNEL_IMAGEGZ=y
BR2_PACKAGE_ALSA_UTILS=y
# BR2_PACKAGE_ALSA_UTILS_ALSAMIXER is not set
BR2_PACKAGE_ALSA_UTILS_AMIXER=y
BR2_PACKAGE_LIBGLVND=y
BR2_PACKAGE_SDL2_X11=y
BR2_PACKAGE_XORG7=y
BR2_PACKAGE_XSERVER_XORG_SERVER=y
BR2_PACKAGE_XLIB_LIBXAW=y
BR2_PACKAGE_XLIB_LIBXCOMPOSITE=y
BR2_PACKAGE_XAPP_XINPUT=y
BR2_PACKAGE_XDRIVER_XF86_INPUT_LIBINPUT=y
BR2_PACKAGE_EVTEST=y
BR2_PACKAGE_LIBXCRYPT=y
BR2_PACKAGE_LIBGUDEV=y
BR2_PACKAGE_LIBIIO=y
# BR2_PACKAGE_LIBIIO_XML_BACKEND is not set
# BR2_PACKAGE_LIBIIO_NETWORK_BACKEND is not set
# BR2_PACKAGE_LIBIIO_USB_BACKEND is not set
# BR2_PACKAGE_LIBIIO_SERIAL_BACKEND is not set
# BR2_PACKAGE_LIBIIO_IIOD is not set
BR2_PACKAGE_LIBUSB=y
BR2_PACKAGE_MTDEV=y
BR2_PACKAGE_READLINE=y
BR2_TARGET_ROOTFS_CPIO=y
BR2_TARGET_ROOTFS_CPIO_GZIP=y
BR2_TARGET_ROOTFS_CPIO_UIMAGE=y
# BR2_TARGET_ROOTFS_TAR is not set
BR2_PACKAGE_HOST_E2FSPROGS=y
BR2_PACKAGE_NEXMON=y
BR2_PACKAGE_NX_FFMPEG=y
# BR2_PACKAGE_NX_FFMPEG_FFMPEG is not set
BR2_PACKAGE_NX_FFMPEG_SWSCALE=y
BR2_PACKAGE_NX_FFMPEG_ENCODERS="png"
BR2_PACKAGE_NX_FFMPEG_DECODERS="h264_nvv4l2"
BR2_PACKAGE_NX_FFMPEG_MUXERS="mp4 image2"
BR2_PACKAGE_NX_FFMPEG_DEMUXERS=""
BR2_PACKAGE_NX_FFMPEG_PARSERS=""
BR2_PACKAGE_NX_FFMPEG_BSFS=""
BR2_PACKAGE_NX_FFMPEG_PROTOCOLS=""
BR2_PACKAGE_NX_FFMPEG_FILTERS=""
# BR2_PACKAGE_NX_FFMPEG_INDEVS is not set
# BR2_PACKAGE_NX_FFMPEG_OUTDEVS is not set
BR2_PACKAGE_VANILLA=y
# BR2_PACKAGE_VANILLA_USE_DRM_KMS is not set
BR2_PACKAGE_VANILLA_USE_NVV4L2=y
BR2_PACKAGE_VANILLA_USE_NX_IMU=y
BR2_PACKAGE_NVIDIA_TEGRA_BSP=y
BR2_PACKAGE_JOYCOND=y
BR2_LINUX_TEGRA_T210_DEPS=y
```

## buildroot/configs/vanilla_orangepi_zero3_defconfig
```kconfig
BR2_aarch64=y
BR2_ARM_FPU_VFPV4=y
BR2_PACKAGE_HOST_LINUX_HEADERS_CUSTOM_6_1=y
BR2_GCC_VERSION_13_X=y
BR2_TOOLCHAIN_BUILDROOT_CXX=y
BR2_GLOBAL_PATCH_DIR="board/orangepi/orangepi-zero3/patches $(BR2_EXTERNAL_VANILLA_PATH)/board/orangepizero3/patches"
BR2_TARGET_GENERIC_ISSUE="Welcome to Orangepi Zero3"
BR2_ROOTFS_DEVICE_CREATION_DYNAMIC_EUDEV=y
# BR2_TARGET_GENERIC_GETTY is not set
BR2_SYSTEM_DHCP="eth0"
BR2_ROOTFS_OVERLAY="$(BR2_EXTERNAL_VANILLA_PATH)/board/orangepizero3/rootfs/"
BR2_ROOTFS_POST_BUILD_SCRIPT="board/orangepi/common/post-build.sh $(BR2_EXTERNAL_VANILLA_PATH)/board/orangepizero3/post_build.sh"
BR2_ROOTFS_POST_IMAGE_SCRIPT="support/scripts/genimage.sh"
BR2_ROOTFS_POST_SCRIPT_ARGS="-c $(BINARIES_DIR)/genimage.cfg"
BR2_LINUX_KERNEL=y
BR2_LINUX_KERNEL_CUSTOM_GIT=y
BR2_LINUX_KERNEL_CUSTOM_REPO_URL="https://github.com/orangepi-xunlong/linux-orangepi.git"
BR2_LINUX_KERNEL_CUSTOM_REPO_VERSION="orange-pi-6.1-sun50iw9"
BR2_LINUX_KERNEL_DEFCONFIG="linux_sunxi64"
BR2_LINUX_KERNEL_CONFIG_FRAGMENT_FILES="$(BR2_EXTERNAL_VANILLA_PATH)/board/orangepizero3/linux-orangepi-zero3-extra.config $(BR2_EXTERNAL_VANILLA_PATH)/board/common/linux-5ghz-softmac.config"
BR2_LINUX_KERNEL_DTS_SUPPORT=y
BR2_LINUX_KERNEL_INTREE_DTS_NAME="allwinner/sun50i-h618-orangepi-zero3"
BR2_LINUX_KERNEL_DTB_KEEP_DIRNAME=y
BR2_LINUX_KERNEL_INSTALL_TARGET=y
BR2_LINUX_KERNEL_NEEDS_HOST_OPENSSL=y
BR2_PACKAGE_MESA3D=y
BR2_PACKAGE_MESA3D_LLVM=y
BR2_PACKAGE_MESA3D_GALLIUM_DRIVER_PANFROST=y
BR2_PACKAGE_MESA3D_OPENGL_EGL=y
BR2_PACKAGE_MESA3D_OPENGL_ES=y
BR2_PACKAGE_LINUX_FIRMWARE=y
BR2_PACKAGE_LINUX_FIRMWARE_ATHEROS_7010=y
BR2_PACKAGE_LINUX_FIRMWARE_ATHEROS_9170=y
BR2_PACKAGE_LINUX_FIRMWARE_ATHEROS_10K_QCA9377=y
BR2_PACKAGE_LINUX_FIRMWARE_MEDIATEK_MT7610E=y
BR2_PACKAGE_LINUX_FIRMWARE_MEDIATEK_MT76X2E=y
BR2_PACKAGE_LINUX_FIRMWARE_MEDIATEK_MT7921=y
BR2_PACKAGE_LINUX_FIRMWARE_RALINK_RT73=y
BR2_PACKAGE_LINUX_FIRMWARE_RALINK_RT2XX=y
BR2_PACKAGE_LINUX_FIRMWARE_RTL_RTW88=y
BR2_PACKAGE_LINUX_FIRMWARE_REDPINE_RS9113=y
BR2_PACKAGE_LINUX_FIRMWARE_REDPINE_RS9116=y
BR2_PACKAGE_RTW88_LWFINGER=y
BR2_PACKAGE_ALSA_LIB=y
BR2_TARGET_ROOTFS_EXT2=y
BR2_TARGET_ROOTFS_EXT2_4=y
BR2_TARGET_ROOTFS_EXT2_SIZE="1000M"
# BR2_TARGET_ROOTFS_TAR is not set
BR2_TARGET_ARM_TRUSTED_FIRMWARE=y
BR2_TARGET_ARM_TRUSTED_FIRMWARE_CUSTOM_VERSION=y
BR2_TARGET_ARM_TRUSTED_FIRMWARE_CUSTOM_VERSION_VALUE="v2.11"
BR2_TARGET_ARM_TRUSTED_FIRMWARE_PLATFORM="sun50i_h616"
BR2_TARGET_UBOOT=y
BR2_TARGET_UBOOT_BUILD_SYSTEM_KCONFIG=y
BR2_TARGET_UBOOT_CUSTOM_GIT=y
BR2_TARGET_UBOOT_CUSTOM_REPO_URL="https://github.com/orangepi-xunlong/u-boot-orangepi.git"
BR2_TARGET_UBOOT_CUSTOM_REPO_VERSION="v2024.01"
BR2_TARGET_UBOOT_BOARD_DEFCONFIG="orangepi_zero3"
BR2_TARGET_UBOOT_NEEDS_DTC=y
BR2_TARGET_UBOOT_NEEDS_PYLIBFDT=y
BR2_TARGET_UBOOT_NEEDS_OPENSSL=y
BR2_TARGET_UBOOT_NEEDS_GNUTLS=y
BR2_TARGET_UBOOT_NEEDS_ATF_BL31=y
BR2_TARGET_UBOOT_SPL=y
BR2_TARGET_UBOOT_SPL_NAME="u-boot-sunxi-with-spl.bin"
BR2_TARGET_UBOOT_CUSTOM_MAKEOPTS="SCP=/dev/null"
BR2_PACKAGE_HOST_GENIMAGE=y
BR2_PACKAGE_HOST_UBOOT_TOOLS=y
BR2_PACKAGE_OPI_FFMPEG=y
BR2_PACKAGE_OPI_FFMPEG_GPL=y
# BR2_PACKAGE_OPI_FFMPEG_FFMPEG is not set
BR2_PACKAGE_OPI_FFMPEG_SWSCALE=y
BR2_PACKAGE_OPI_FFMPEG_ENCODERS="png"
BR2_PACKAGE_OPI_FFMPEG_DECODERS="h264"
BR2_PACKAGE_OPI_FFMPEG_MUXERS="mp4 image2"
BR2_PACKAGE_OPI_FFMPEG_DEMUXERS=""
BR2_PACKAGE_OPI_FFMPEG_PARSERS=""
BR2_PACKAGE_OPI_FFMPEG_BSFS=""
BR2_PACKAGE_OPI_FFMPEG_PROTOCOLS=""
BR2_PACKAGE_OPI_FFMPEG_FILTERS=""
# BR2_PACKAGE_OPI_FFMPEG_INDEVS is not set
# BR2_PACKAGE_OPI_FFMPEG_OUTDEVS is not set
BR2_PACKAGE_VANILLA=y
```

## buildroot/configs/vanilla_raspberrypi_64_defconfig
```kconfig
BR2_aarch64=y
BR2_ARM_FPU_VFPV4=y
BR2_TOOLCHAIN_EXTERNAL=y
BR2_TOOLCHAIN_EXTERNAL_BOOTLIN=y
BR2_GLOBAL_PATCH_DIR="board/raspberrypi/patches"
BR2_DOWNLOAD_FORCE_CHECK_HASHES=y
BR2_ROOTFS_DEVICE_CREATION_DYNAMIC_EUDEV=y
# BR2_TARGET_GENERIC_GETTY is not set
BR2_ROOTFS_OVERLAY="$(BR2_EXTERNAL_VANILLA_PATH)/rootfs/"
BR2_ROOTFS_POST_BUILD_SCRIPT="board/raspberrypi/post-build.sh $(BR2_EXTERNAL_VANILLA_PATH)/board/raspberrypi/post_build.sh"
BR2_ROOTFS_POST_IMAGE_SCRIPT="board/raspberrypi/post-image.sh"
BR2_LINUX_KERNEL=y
BR2_LINUX_KERNEL_CUSTOM_TARBALL=y
BR2_LINUX_KERNEL_CUSTOM_TARBALL_LOCATION="$(call github,raspberrypi,linux,ac69f097e1fba94502cbd36278db204120a37943)/linux-ac69f097e1fba94502cbd36278db204120a37943.tar.gz"
BR2_LINUX_KERNEL_DEFCONFIG="bcm2711"
BR2_LINUX_KERNEL_CONFIG_FRAGMENT_FILES="$(BR2_EXTERNAL_VANILLA_PATH)/board/common/linux-5ghz-softmac.config $(BR2_EXTERNAL_VANILLA_PATH)/board/raspberrypi/linux-6.12-5ghz-softmac.config"
BR2_LINUX_KERNEL_DTS_SUPPORT=y
BR2_LINUX_KERNEL_INTREE_DTS_NAME="broadcom/bcm2710-rpi-2-b broadcom/bcm2710-rpi-3-b broadcom/bcm2710-rpi-3-b-plus broadcom/bcm2710-rpi-cm0 broadcom/bcm2710-rpi-cm3 broadcom/bcm2710-rpi-zero-2 broadcom/bcm2710-rpi-zero-2-w broadcom/bcm2711-rpi-4-b broadcom/bcm2711-rpi-400 broadcom/bcm2711-rpi-cm4 broadcom/bcm2711-rpi-cm4-io broadcom/bcm2711-rpi-cm4s broadcom/bcm2712-rpi-5-b broadcom/bcm2712-rpi-500 broadcom/bcm2712-rpi-cm5-cm4io broadcom/bcm2712-rpi-cm5-cm5io broadcom/bcm2712-rpi-cm5l-cm4io broadcom/bcm2712-rpi-cm5l-cm5io"
BR2_LINUX_KERNEL_NEEDS_HOST_OPENSSL=y
BR2_PACKAGE_BUSYBOX_SHOW_OTHERS=y
BR2_PACKAGE_XZ=y
BR2_PACKAGE_MESA3D=y
BR2_PACKAGE_MESA3D_GALLIUM_DRIVER_VC4=y
BR2_PACKAGE_MESA3D_GALLIUM_DRIVER_V3D=y
BR2_PACKAGE_MESA3D_OPENGL_EGL=y
BR2_PACKAGE_MESA3D_OPENGL_ES=y
BR2_PACKAGE_SDL2=y
BR2_PACKAGE_SDL2_KMSDRM=y
BR2_PACKAGE_SDL2_OPENGLES=y
BR2_PACKAGE_SDL2_IMAGE=y
BR2_PACKAGE_SDL2_TTF=y
BR2_PACKAGE_LINUX_FIRMWARE=y
BR2_PACKAGE_LINUX_FIRMWARE_ATHEROS_7010=y
BR2_PACKAGE_LINUX_FIRMWARE_ATHEROS_9170=y
BR2_PACKAGE_LINUX_FIRMWARE_ATHEROS_10K_QCA9377=y
BR2_PACKAGE_LINUX_FIRMWARE_MEDIATEK_MT7610E=y
BR2_PACKAGE_LINUX_FIRMWARE_MEDIATEK_MT76X2E=y
BR2_PACKAGE_LINUX_FIRMWARE_MEDIATEK_MT7921=y
BR2_PACKAGE_LINUX_FIRMWARE_MEDIATEK_MT7925=y
BR2_PACKAGE_LINUX_FIRMWARE_RALINK_RT73=y
BR2_PACKAGE_LINUX_FIRMWARE_RALINK_RT2XX=y
BR2_PACKAGE_LINUX_FIRMWARE_RTL_RTW88=y
BR2_PACKAGE_LINUX_FIRMWARE_RTL_RTW89=y
BR2_PACKAGE_LINUX_FIRMWARE_REDPINE_RS9113=y
BR2_PACKAGE_LINUX_FIRMWARE_REDPINE_RS9116=y
BR2_PACKAGE_RTW88_LWFINGER=y
BR2_PACKAGE_RTW89_MORROWNR=y
BR2_PACKAGE_RPI_FIRMWARE=y
BR2_PACKAGE_RPI_FIRMWARE_BOOTCODE_BIN=y
BR2_PACKAGE_RPI_FIRMWARE_VARIANT_PI=y
BR2_PACKAGE_RPI_FIRMWARE_VARIANT_PI4=y
BR2_PACKAGE_RPI_FIRMWARE_CONFIG_FILE="$(BR2_EXTERNAL_VANILLA_PATH)/board/raspberrypi/config_raspberrypi_64bit.txt"
BR2_PACKAGE_RPI_FIRMWARE_CMDLINE_FILE="$(BR2_EXTERNAL_VANILLA_PATH)/board/raspberrypi/cmdline.txt"
BR2_PACKAGE_ALSA_LIB=y
BR2_PACKAGE_OPENSSL=y
BR2_PACKAGE_LIBXML2=y
BR2_PACKAGE_LIBNL=y
BR2_PACKAGE_LIBEVDEV=y
BR2_PACKAGE_KMOD_TOOLS=y
BR2_TARGET_ROOTFS_EXT2=y
BR2_TARGET_ROOTFS_EXT2_4=y
BR2_TARGET_ROOTFS_EXT2_SIZE="120M"
# BR2_TARGET_ROOTFS_TAR is not set
BR2_PACKAGE_HOST_DOSFSTOOLS=y
BR2_PACKAGE_HOST_GENIMAGE=y
BR2_PACKAGE_HOST_KMOD_XZ=y
BR2_PACKAGE_HOST_MTOOLS=y
BR2_PACKAGE_RPI_FFMPEG=y
# BR2_PACKAGE_RPI_FFMPEG_FFMPEG is not set
BR2_PACKAGE_RPI_FFMPEG_SWSCALE=y
BR2_PACKAGE_RPI_FFMPEG_ENCODERS="png"
BR2_PACKAGE_RPI_FFMPEG_DECODERS="h264_v4l2m2m"
BR2_PACKAGE_RPI_FFMPEG_MUXERS="mp4 image2"
BR2_PACKAGE_RPI_FFMPEG_DEMUXERS=""
BR2_PACKAGE_RPI_FFMPEG_PARSERS=""
BR2_PACKAGE_RPI_FFMPEG_BSFS=""
BR2_PACKAGE_RPI_FFMPEG_PROTOCOLS=""
BR2_PACKAGE_RPI_FFMPEG_FILTERS=""
# BR2_PACKAGE_RPI_FFMPEG_INDEVS is not set
# BR2_PACKAGE_RPI_FFMPEG_OUTDEVS is not set
BR2_PACKAGE_VANILLA=y
```

## buildroot/package/Config.in
```kconfig
source "$BR2_EXTERNAL_VANILLA_PATH/package/nexmon/Config.in"
source "$BR2_EXTERNAL_VANILLA_PATH/package/opi-ffmpeg/Config.in"
source "$BR2_EXTERNAL_VANILLA_PATH/package/rpi-ffmpeg/Config.in"
source "$BR2_EXTERNAL_VANILLA_PATH/package/rtw88-lwfinger/Config.in"
source "$BR2_EXTERNAL_VANILLA_PATH/package/rtw89-morrownr/Config.in"
source "$BR2_EXTERNAL_VANILLA_PATH/package/vanilla/Config.in"
source "$BR2_EXTERNAL_VANILLA_PATH/package/nvidia-tegra-bsp/Config.in"
source "$BR2_EXTERNAL_VANILLA_PATH/package/joycond/Config.in"
```

## buildroot/package/rtw88-lwfinger/Config.in
```kconfig
comment "rtw88-lwfinger needs a Linux kernel to be built"
	depends on !BR2_LINUX_KERNEL

config BR2_PACKAGE_RTW88_LWFINGER
	bool "rtw88-lwfinger"
	depends on BR2_LINUX_KERNEL
	help
	  Realtek rtw88 drivers

	  https://github.com/lwfinger/rtw88
```

## buildroot/package/rtw89-morrownr/Config.in
```kconfig
comment "rtw89-morrownr needs a Linux kernel to be built"
	depends on !BR2_LINUX_KERNEL

config BR2_PACKAGE_RTW89_MORROWNR
	bool "rtw89-morrownr"
	depends on BR2_LINUX_KERNEL
	help
	  Realtek rtw89 drivers

	  https://github.com/morrownr/rtw89
```

## buildroot/package/vanilla/Config.in
```kconfig
config BR2_PACKAGE_VANILLA
	bool "vanilla"
	help
		Install Vanilla, the Wii U gamepad reimplementation

		https://github.com/vanilla-wiiu/vanilla

if BR2_PACKAGE_VANILLA

config BR2_PACKAGE_VANILLA_BUILD_GUI
    bool "Enable GUI"
    default y
    select BR2_PACKAGE_SDL2
    select BR2_PACKAGE_SDL2_TTF
    select BR2_PACKAGE_SDL2_IMAGE
    select BR2_PACKAGE_LIBXML2
    help
        Build the frontend. Enable if you're building a fully embedded
        device for Vanilla, disable if the device is only handling
        the connection to the Wii U.

config BR2_PACKAGE_VANILLA_BUILD_PIPE
    bool "Enable pipe"
    default y
    select BR2_PACKAGE_LIBNL
    help
        Build the pipe. Enable if this device can connect to the Wii U
        on its own. Disable if it will need to go through a separate
        device (called a "pipe") to make the connection.

config BR2_PACKAGE_VANILLA_USE_VAAPI
    bool "Enable VAAPI"

config BR2_PACKAGE_VANILLA_USE_DRM_KMS
    bool "Enable direct DRM/KMS video output"
    default y
    select BR2_PACKAGE_SDL2_OPENGLES
    select BR2_PACKAGE_SDL2_KMSDRM

config BR2_PACKAGE_VANILLA_USE_NVV4L2
    bool "Enable Tegra NVV4L2 hardware decoding"
    select BR2_PACKAGE_LIBDRM
    select BR2_PACKAGE_LIBV4L
    select BR2_PACKAGE_SDL2_OPENGLES
    help
        Enable h264_nvv4l2 via FFmpeg (FFmpeg must provide h264_nvv4l2)

config BR2_PACKAGE_VANILLA_USE_NX_IMU
    bool "Use Nintendo Switch motion sensors"

config BR2_PACKAGE_VANILLA_USE_LOCAL
    bool "Local build"
    help
        Use a local build directory rather than pulling from GitHub.
        Useful for Docker builds or development.

config BR2_PACKAGE_VANILLA_LOCAL_PATH
    depends on BR2_PACKAGE_VANILLA_USE_LOCAL
    string "Local repository path"
    help
        Local directory to build Vanilla.

endif
```
